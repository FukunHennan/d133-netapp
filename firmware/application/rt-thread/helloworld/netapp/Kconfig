## firmware/application/rt-thread/helloworld/netapp/Kconfig
```kconfig
menuconfig D133_NETAPP
    bool "D133 AP provisioning and OS A/B OTA"
    depends on AIC_WLAN_REALTEK && LPKG_USING_LWIP
    select LPKG_LWIP_USING_DHCPD
    select LPKG_USING_WEBCLIENT
    select LPKG_USING_OTA_DOWNLOADER
    select AIC_OTA_INTERFACE
    select AIC_ENV_INTERFACE
    select AIC_AB_SYSTEM_INTERFACE
    select AIC_SYS_REDUNDAND_ENVIRONMENT
    default n

if D133_NETAPP
config D133_SETUP_PASSWORD
    string "Setup AP WPA2 password (8-63 characters)"
    default "D133setup"

config D133_OTA_TOKEN
    string "Web OTA password (independent from the setup AP password)"
    default "D133ota"
endif
```
